## drivers/stm/Kconfig
```kconfig
#
# STM specific device configuration
#

config STM_DRIVERS
	def_bool n
	select ARCH_REQUIRE_GPIOLIB

menu "STM specific devices"
        depends on STM_DRIVERS

config STM_PCI_EMISS
	bool "STMicroelectronics PCI controller"
	depends on PCI && (CPU_SUBTYPE_STX7108)
	def_bool n
	---help---
	  This option adds support for the PCI controller found on some
	  STMicroelectronics SOCs.

# PCIe controller from synopsys, wrapped for HVD parts
config STM_PCIE
	bool "STMicroelectronics PCI express controller"
	depends on PCI && (CPU_SUBTYPE_STX7108 || CPU_SUBTYPE_STXH205 || \
		ARCH_STM)
	def_bool n
	select ARCH_SUPPORTS_MSI
	---help---
	  This option adds support for the PCI express controller found on some
	  STMicroelectronics SOCs.

config STM_MIPHY
	def_bool y

config STM_MIPHY_TAP
	bool
	depends on STM_MIPHY
	default y if CPU_SUBTYPE_STX7108
	default y if CPU_SUBTYPE_STIH415
	default n

config STM_MIPHY_PCIE_MP
	bool "STMicroelectronics MiPhy Uport"
	depends on STM_MIPHY
	default y if CPU_SUBTYPE_STX7108
	default y if MACH_STM_STID127
	default y if CPU_SUBTYPE_STXH205
	default y if CPU_SUBTYPE_STIH415
	default y if MACH_STM_STIH416
	default y if MACH_STM_STIH407
	default y if CPU_SUBTYPE_STXH205
	default n
       ---help---
        This option adds support for the UPort interface to MiPhy.


config STM_MIPHY_DUMMY
	bool
	depends on STM_MIPHY
	default n

config STM_MIPHY365X
	bool
	depends on STM_MIPHY
	default y if CPU_SUBTYPE_STX7108
	default y if CPU_SUBTYPE_STIH415
	default y if MACH_STM_STIH416
	default n

config STM_MIPHYA40X
	bool
	depends on STM_MIPHY
	default y if MACH_STM_STID127
	default y if CPU_SUBTYPE_STXH205
	default n

config STM_MIPHY28LP
	bool
	depends on STM_MIPHY
	default y if MACH_STM_STIH407

config STPIO
	bool "Legacy stpio API"
	default n
	help
	  Select this option to enable the legacy stpio interface. No
	  code within the kernel uses this API, it is retained only for
	  drivers outside the kernel which might still need it.

config STM_COPROCESSOR_CLASS
	tristate "STMicroelectronics coprocessor support"
	select FW_LOADER
	select BPA2
	select LIBELF_32
	---help---
	  Many of the ST system-on-chip devices have multiple CPUs, where a
	  master CPU running Linux has control over a number of slave CPUs,
	  which are usually used to run dedicated algorithms.
	  Enabling this option will add support to the Linux kernel to
	  control these slave CPUs, reserve memory for them, and thus allow
	  code to be downloaded onto them and executed.

	  Memory allocation is managed through BPA2 so, to define a
	  coprocessor's memory size and address, use the normal BPA2
	  command line option:
	    bpa2_parts=<name0>:<size0>:<address0>,<name1>:<size1>:<address1>,...
	  where:
	    <nameX> is "coproc_" followed by the coprocessor name, for example
	    "audio0".
	    <sizeX> defines the size of the partition
	    <addressX> defines the base address of memory reserved for the
	    coprocessor application code and data.

	  For example:
	    bpa2_parts=coproc_video0:16m:0x06000000,coproc_audio0:16m:0x07000000

	  As with all other BPA2 addresses, addresses are physical addresses,
	  and so may appear at different virtual addresses when mapped into the
	  CPU's memory map.

config STM_COPROCESSOR_ST40
	tristate "ST40 coprocessor support"
	depends on STM_COPROCESSOR_CLASS
	---help---
	  Provide support for ST40 coprocessor hardware.

config STM_COPROCESSOR_ST200
	tristate "ST200 coprocessor support"
	depends on STM_COPROCESSOR_CLASS
	---help---
	  Provide support for ST200 coprocessor hardware.

config  COPROCESSOR_DEBUG
        depends on STM_COPROCESSOR_CLASS
        bool "STM coprocessor debug"
        default n
        ---help---
          Enable this option to print out information about the slave CPUs
          addresses and operations you are using for coprocessor.

config STM_RNG
       bool "STM Random Number Generator Support"
       default y
       ---help---
         This option adds support for the hardware Random Number Generator
         (RNG) present on different STMicroelectronics SoCs.  It allows the
         RNG to feed /dev/random with entropy thereby ensuring real
         random numbers from this device.

         Without this option, /dev/random has little entropy and is not
         useful.  In fact, it may block for a long time while waiting for
         entropy.

         This option should always be enabled for relevant SoCs.

         This option can be used in conjunction with the /dev/hw_random
         driver found in the char drivers menu.

config STM_SYSTRACE
	bool "System Trace Module"
        depends on (STM_DRIVERS && ARCH_STM)
	select MTT
	default y
	---help---
	  The System Trace Module peripheral complies with MIPI-Alliance
	  specifications for the System Trace Protocol(STP) v2.
	  See http://www.mipi.org/specifications/debug and in Documentation
	  systrace.txt and mtt.txt.
	  The trace data is built and written through the MTT Trace facility
	  (see mtt-systrace.txt), and output on the MIPI wires.

config STM_AMBA_BRIDGE
	bool
        depends on STM_DRIVERS
	default y

config STM_IRQ_MUX
	depends on STM_DRIVERS
	bool "STM IRQ-Mux support"
	default n
	---help---
	  Enable this option to support IRQ-MUX mapping in the kernel.

config PMS
	bool "Power Management Scheme"
	default n
	select PM_RUNTIME
	help
	  This option enables the STMicroelectronics Power Management
	  Scheme (PMS).

	  This is a kernel framework based around power profiles (pms_state),
	  where the designer can specify devices power states and the
	  clock frequency rates.
	  Moving the system between pms_states the user application can
	  tune the power consumption according with what the system is doing.

config PMS_CHECK_GROUP
	bool "PMS always checks the state group"
	depends on PMS
	default n
	help
	  Enable this option if the state group has to be controlled.
	  When a group of pms_states are enabled in the same time, this option
	  forces the PMS to check that there is no conflict inside the group
	  itself. In case of conflict the group is rejected.

config PMS_DEBUG
	bool "PMS debug"
	default n
	depends on PMS
	help
	  Enable this option to print out information about the PMS

config STM_LPM
	bool "STM Low Power Monitor"
	depends on CPU_SUBTYPE_STXH205  || CPU_SUBTYPE_STX7108
	select LIBELF_64
	default n
	help
	 Enable this option for Standby Controller support.

config STM_LPM_NEW
        bool "STM Low Power Monitor New Implementation"
        depends on STM_LPM
        default n
        ---help---
          This option adds support for the hardware low power monitor.

config STM_LPM_POWER_PIO
        hex "POWER CONTROL PIO"
        depends on STM_LPM && CPU_SUBTYPE_STXH205 && HIBERNATION_ON_MEMORY
        default "0x0371"
        ---help---
                This option is to select power on PIO .
                This information will be used by SBC to do power off SOC/board
                Format to define POWER_PIO_IS_BELOW
                0xnnpe, nn is PIO number
                p is PIO pin number, This value can vary from 0 to 7
                e is pio edge on which power will be off
                e 1 means pio high will do power off
                e 0  means pio low will do power off
                possible values are l and 0
                default 0x0371 means PIO 3, PIN7 and level high will  do power
config  STM_HOM_HPD_ENABLE
        bool "This enables HDMI HPD support wakeup from HOM"
        depends on STM_LPM && CPU_SUBTYPE_STXH205 && HIBERNATION_ON_MEMORY
        default n
        ---help---
                HDMI HPS PIO must be in always on domain
                Enable this option and select STM_LPM_HDMI_HPD, on which
                PIO HDMI HPD signal is connected

config STM_LPM_HDMI_HPD
       hex "HDMI HPD PIO"
       depends on STM_HOM_HPD_ENABLE
       default "0x25"
       ---help---
               This option is to select HDMI HPD PIO for External Interrupt.
               0xab , ab is PIO number
               where a is PIO_PORT and b is PIO_PIN

config STM_LPM_SBC_SOFT_WDT
        bool "This enables Software watchdog for SBC"
        depends on STM_LPM && CPU_SUBTYPE_STXH205 && HIBERNATION_ON_MEMORY
        default n
        ---help---
                This option will be enabled for software watchdog for SBC
                Using this Host driver will check SBC status and in case of
                problem Host will reset and reload SBC firmware

config STM_LPM_RD_MONITOR
        bool "STM Low Power Monitor power key press on GPIO"
        depends on STM_LPM && CPU_SUBTYPE_STX7108
        default n
        ---help---
        This enable intercept of GPIO(7108_RD signal on HDK7108 boards ).
        This GPIO is connected to 7108 HDK board's front panel
        There is stm8 controller on front panel, when user presses standby
        button on FP, STM8 drive this PIO so that SOC knows FP activity
        STLPM driver intercept this GPIO and export to user land via sys-fs
        Applcation can track powerkey in sysfs to check if key on front panel
        is pressed or not.

        depends on CPU_SUBTYPE_STXH205
        select LIBELF_64
        default n
        help
         Enable this option for Standby Controller support.

config STM_LPM_POWER_PIO
        hex "STM Low Power GPIO Power-on/off"
        depends on STM_LPM
        default "0x370"
        help
          This option is to select power on PIO .
          This information will be used by SBC to do power off SOC/board
          Format is encoded as "0xnnpe" where:
                nn is GPIO port number;
                p is GPIO pin number;
                e is pio edge on which power will be off
                - 1 means pio high will do power off
                - 0 means pio low will do power off

config STM_LPM_POWER_PIO
	hex "STM Low Power GPIO Power-on/off"
	depends on STM_LPM
	default "0x370"
	help
	  This option is to select power on PIO .
	  This information will be used by SBC to do power off SOC/board
	  Format is encoded as "0xnnpe" where:
		nn is GPIO port number;
		p is GPIO pin number;
		e is pio edge on which power will be off
		- 1 means pio high will do power off
		- 0 means pio low will do power off

config STM_LPM_DEBUG
	bool "STM Low Power Monitor debug"
	depends on STM_LPM
	default n
	help
	 Enable this option to print debug information.

source "drivers/stm/mali/Kconfig"
endmenu
```
